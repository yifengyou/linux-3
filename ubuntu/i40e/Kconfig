## ubuntu/i40e/Kconfig
```kconfig
config I40E_BPO
	tristate "Intel(R) Ethernet Controller XL710 Family support (bpo)"
	select PTP_1588_CLOCK
	depends on PCI
	---help---
	  This driver supports Intel(R) Ethernet Controller XL710 Family of
	  devices.  For more information on how to identify your adapter, go
	  to the Adapter & Driver ID Guide at:

	  <http://support.intel.com/support/network/adapter/pro100/21397.htm>

	  For general information and support, go to the Intel support
	  website at:

	  <http://support.intel.com>

	  To compile this driver as a module, choose M here. The module
	  will be called i40e_bpo.

config I40E_BPO_VXLAN
	bool "Virtual eXtensible Local Area Network Support"
	default n
	depends on I40E_BPO && VXLAN && !(I40E_BPO=y && VXLAN=m)
	---help---
	  This allows one to create VXLAN virtual interfaces that provide
	  Layer 2 Networks over Layer 3 Networks. VXLAN is often used
	  to tunnel virtual network infrastructure in virtualized environments.
	  Say Y here if you want to use Virtual eXtensible Local Area Network
	  (VXLAN) in the driver.

config I40E_BPO_DCB
	bool "Data Center Bridging (DCB) Support"
	default n
	depends on I40E_BPO && DCB
	---help---
	  Say Y here if you want to use Data Center Bridging (DCB) in the
	  driver.

	  If unsure, say N.
```
